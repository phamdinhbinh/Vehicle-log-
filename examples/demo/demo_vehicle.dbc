VERSION "Vehicle Log Studio synthetic demo"

NS_ :

BS_:
BU_: BMS VCU

BO_ 256 Battery: 8 BMS
 SG_ PackVoltage : 0|16@1+ (0.1,0) [0|6553.5] "V" VCU
 SG_ PackCurrent : 16|16@1- (0.1,0) [-3276.8|3276.7] "A" VCU

BO_ 257 Vehicle: 8 VCU
 SG_ VehicleSpeed : 0|16@1+ (0.01,0) [0|655.35] "km/h" BMS
